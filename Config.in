## esp32/sdkconfig.defaults
```kconfig
CONFIG_IDF_TARGET="esp32s3"
CONFIG_ESPTOOLPY_FLASHSIZE_16MB=y
CONFIG_ESPTOOLPY_FLASHMODE_QIO=y
CONFIG_PARTITION_TABLE_CUSTOM=y
CONFIG_PARTITION_TABLE_CUSTOM_FILENAME="partitions.csv"
CONFIG_ESP_DEFAULT_CPU_FREQ_MHZ_240=y
CONFIG_SPIRAM=y
CONFIG_SPIRAM_MODE_OCT=y
CONFIG_SPIRAM_SPEED_80M=y
CONFIG_SPIRAM_XIP_FROM_PSRAM=y
CONFIG_SPIRAM_MALLOC_ALWAYSINTERNAL=4096
CONFIG_SPIRAM_TRY_ALLOCATE_WIFI_LWIP=y
CONFIG_ESP32S3_DATA_CACHE_64KB=y
CONFIG_ESP32S3_DATA_CACHE_LINE_64B=y
CONFIG_ESP32S3_INSTRUCTION_CACHE_32KB=y
CONFIG_COMPILER_OPTIMIZATION_PERF=y
CONFIG_FREERTOS_HZ=1000
CONFIG_ESP_MAIN_TASK_STACK_SIZE=8192
CONFIG_ESP_CONSOLE_USB_SERIAL_JTAG=y
CONFIG_LCD_RGB_ISR_IRAM_SAFE=y
CONFIG_BSP_LCD_RGB_BUFFER_NUMS=2
CONFIG_BSP_LCD_RGB_BOUNCE_BUFFER_HEIGHT=10
CONFIG_BSP_DISPLAY_LVGL_AVOID_TEAR=y
CONFIG_BSP_DISPLAY_LVGL_FULL_REFRESH=y
CONFIG_LV_COLOR_DEPTH_16=y
CONFIG_LV_MEM_CUSTOM=y
CONFIG_LV_USE_CLIB_MALLOC=y
CONFIG_LV_USE_CLIB_STRING=y
CONFIG_LV_USE_CLIB_SPRINTF=y
CONFIG_LV_FONT_MONTSERRAT_14=y
CONFIG_LV_FONT_MONTSERRAT_20=y
CONFIG_LV_FONT_MONTSERRAT_28=y
CONFIG_LV_FONT_MONTSERRAT_48=y
CONFIG_LV_USE_LODEPNG=y
CONFIG_LV_USE_TJPGD=y
CONFIG_LV_USE_FS_STDIO=y
CONFIG_LV_FS_STDIO_LETTER=83
CONFIG_LV_USE_QRCODE=y
CONFIG_LV_USE_OBSERVER=y
CONFIG_HTTPD_MAX_REQ_HDR_LEN=2048
CONFIG_HTTPD_MAX_URI_LEN=1024
CONFIG_MBEDTLS_CERTIFICATE_BUNDLE=y
CONFIG_MBEDTLS_CERTIFICATE_BUNDLE_DEFAULT_FULL=y
CONFIG_ESP_WIFI_NVS_ENABLED=y
CONFIG_LWIP_SNTP_MAX_SERVERS=3
CONFIG_LV_USE_SNAPSHOT=y
CONFIG_LV_CACHE_DEF_SIZE=3145728
CONFIG_LV_IMAGE_HEADER_CACHE_DEF_CNT=8
CONFIG_LV_USE_KEYBOARD=y
CONFIG_LV_USE_TEXTAREA=y
CONFIG_LV_USE_LIST=y
```

## package/scholartech-prayer/Config.in
```kconfig
config BR2_PACKAGE_SCHOLARTECH_PRAYER
	bool "scholartech-prayer"
	depends on BR2_PACKAGE_PYTHON3
	depends on BR2_PACKAGE_COG
	select BR2_PACKAGE_GIT # app updates
	help
	  ScholarTechOS prayer display: the three-page screen (prayer
	  times, notices, both) shown in the kiosk browser, and its
	  settings page for phones and computers (port 8420).
	  Turns the screen into a prayer display (/etc/scholartech/app.conf).

	  The app is apps/prayer, copied from display_template with
	  scripts/update-prayer-app.sh. Newer releases (tags) are installed
	  from GitHub with a read-only deploy key (secrets/prayer-deploy-key).
```
